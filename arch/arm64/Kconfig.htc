## arch/arm64/Kconfig.htc
```kconfig
comment "HTC Debugging Features"
menuconfig HTC_DEBUG
        bool "HTC Debugging Feature Switch"
        default y
        help
          Enable collection of debug features.
          This feature is enabled in defconfig.

comment "HTC features"
menuconfig HTC_FEATURES
        bool "HTC Implement Features"
        default n
        help
          Enable collection of HTC features.
          This feature is enabled in defconfig.

if HTC_FEATURES

config HTC_MODEM_EXCEPTION_INFO_EXPORT
        bool "HTC modem exception info export"
        depends on HTC_FEATURES && MTK_ECCCI_DRIVER
        default n
        help
          export modem exception info for tell htc

config HTC_MODEM_EXCEPTION_INFO_EXPORT_C2K
        bool "C2k modem exception info export"
        depends on HTC_FEATURES && MTK_C2K_SUPPORT
        default n
        help
          export c2k modem exception info for tell htc


comment "HTC Debug Flag"
menuconfig HTC_ORR
	bool "HTC Debug Flag Features"
        default y
	help
          Enable Debug Flag features.

config HTC_FEATURES_RIL_PCN0004_HTC_GARBAGE_FILTER
        tristate "HTC_FEATURES_RIL_PCN0004_HTC_GARBAGE_FILTER"
        default n
        depends on MTK_ECCCI_DRIVER && HTC_FEATURES
        ---help---
          Garbage Filter of TCP
endif
```

## drivers/i2c/chips/Kconfig
```kconfig
#
# Miscellaneous I2C chip drivers configuration
#
# *** DEPRECATED! Do not add new entries! See Makefile ***
#

menu "Miscellaneous I2C Chip support"

config AMP_RT5506
        tristate "Richtek RT5506 AMP Driver"
	depends on I2C=y
        help
          Richtek RT5506 AMP Driver implemented by HTC.

config AMP_TFA9895
	tristate "NXP TFA9895 Speaker AMP Driver"
	depends on I2C=y
	help
		NXP TFA9895 Speaker AMP Driver implemented by HTC.

config AMP_TFA9895L
	tristate "NXP TFA9895L Speaker AMP Driver"
	depends on I2C=y
	help
		NXP TFA9895L Speaker AMP Driver implemented by HTC.

config SENSORS_NFC_PN544
	tristate "PN544 NFC sensor support"
	depends on I2C=y
	help
	  PN544 NFC Driver implemented.

config INPUT_CWSTM32
	tristate "CyWee CWSTM32 Sensor HUB"
	depends on I2C && INPUT
	select INPUT_POLLDEV
	help
		This driver provides support for CWSTM32 Sensor HUB

config CWSTM32_DEBUG
	tristate "CyWee CWSTM32 Sensor HUB DEBUG MECHANISM"
	depends on INPUT_CWSTM32
	help
		This driver depends on CWSTM32 Sensor HUB for enable DEBUG.

config CIR_ALWAYS_READY
	bool "BMA250 CIR Always Ready"
	default n
	help
		Enable CIR Always Ready

config KIONIX_KXTJ2
	tristate "KXTJ2 acceleration sensor support"
	depends on I2C=y
	help
		If you say yes here you get support for Kionix Sensortec's
		acceleration sensors KXTJ2.

config BOSCH_BMA253
	tristate "BMA253 acceleration sensor support"
	depends on I2C=y
	help
		If you say yes here you get support for Bosch Sensortec's
		acceleration sensors BMA253.

config BOSCH_BMA253_ENABLE_INT1
       tristate "BMA253 acceleration sensor interrupt INT1 support"
       depends on BOSCH_BMA253=y
        help
         If you say yes here you get INT1 support for Bosch Sensortec's
         acceleration sensors BMA253.

config BOSCH_BMA253_ENABLE_INT2
       tristate "BMA253 acceleration sensor interrupt INT2 support"
       depends on BOSCH_BMA253=y
       help
         If you say yes here you get INT2 support for Bosch Sensortec's
         acceleration sensors BMA253.

config SENSORS_BMM050
	tristate "BMM050 Magnetic Sensor Driver"
	depends on I2C
	help
	 If you say yes here, you get support for Bosch Sensortec's
	 sensor BMM050 Magnetic Sensor

config INPUT_CAPELLA_CM36686
       tristate "CM36686 proximity and light sensor"
       help
       Say Y here to enable the CM36686 Short Distance Proximity
       Sensor with Ambient Light Sensor.

config SENSORS_AK09911
       tristate "AK09911 compass support"
       default n
       depends on I2C
       help
		If you say yes here you get support for Asahi Kasei's
		orientation sensor AK09911.

endmenu
```

## drivers/iio/sensorhub/Kconfig
```kconfig
#
# IIO Sensor Hub drivers
#
menu "Sensor Hubs"
source "drivers/iio/sensorhub/sentral/Kconfig"

endmenu
```

## drivers/iio/sensorhub/sentral/Kconfig
```kconfig
#
# SENtral Sensor Hub driver
#

config SENTRAL_IIO
	tristate "SENtral Sensor Hub (IIO)"
	depends on I2C && SYSFS && IIO && IIO_KFIFO_BUF
	default m
	help
	  This driver supports the SENtral Sensor Hub using IIO
	  This driver can be built as a module.

config HUB_SENTRAL_MFG
	tristate "SENtral Sensor Hub MFG FLAG FOR TURN OFF AUTOK"
	depends on I2C
	default n
	help
	  sentral sensor hub MFG flag
```

## drivers/misc/mediatek/flashlight/Kconfig
```kconfig
config MTK_FLASHLIGHT
  bool CONFIG_MTK_FLASHLIGHT
  default n
  help
    CONFIG_MTK_FLASHLIGHT

config HTC_FLASHLIGHT_COMMON
        tristate "Common flashlight API for camera"
        help
          Say Y here to enable the common API for front flashlight utilization

config FLASHLIGHT_SY7803
        tristate "SILERGY SY7803 flashlight"
        help
          Say Y here to enable the SILERGY SY7803 flashlight

config FLASHLIGHT_SGM3785
        tristate "SGMICRO SGM3785 flashlight"
        help
          Say Y here to enable the SILERGY SGM3785 flashlight
```
